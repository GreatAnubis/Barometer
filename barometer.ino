/*
   barometer.ino - Piccolino Pressure & Temperature display using the BMP180 sensor add-on
   Visit http://piccolino.rocks to get this low cost sensor and add it to your Piccolino!
   
   This demo uses Sparkfun's SFE_BMP180 library ( https://github.com/sparkfun/BMP180_Breakout/tree/master/Libraries/Arduino/src )
   
   To install the library, make a folder called SFE_BMP180 in your ... Arduino/libraries 
   go into the folder and drop the SFE_BMP180.cpp and SFE_BMP180.h files. Restart the Arduino IDE and compile this demo.
   
   Written by Alex Sardo (wctek.com) for Piccolino -> http://piccolino.rocks
  
   Feel free to do whatever you want with it. Have fun!
   
*/

#include <Wire.h>
#include <SPI.h>
#include <Piccolino_OLED.h>
#include <Piccolino_RAM.h>
#include "DHT.h"

#define DHTPIN A0     // what pin we're connected to
#define DHTTYPE DHT11   // DHT 11
DHT dht(DHTPIN, DHTTYPE);
//#include <SFE_BMP180.h>

// You will need to create an SFE_BMP180 object, here called "pressure":
//SFE_BMP180 pressure;

// Piccolino OLED driver
Piccolino_OLED oled;
Piccolino_RAM ram;

//change the below ALTITUDE to your own location. In google, search for: altitude suburb,state (ie: altitude spring,texas)
//value must be in meters
#define ALTITUDE 37 // Spring, Texas is 37 meters (121ft)

// 4 images for the weather screen toggler
PROGMEM const unsigned char sunny [] = {
0x00, 0x00, 0x00, 0x00, 0x00, 0x00, 0x00, 0x00, 0x00, 0x00, 0x00, 0x00, 0x00, 0x00, 0x00, 0x00,
0x00, 0x00, 0x00, 0x00, 0x00, 0x00, 0x00, 0x00, 0x00, 0x00, 0x00, 0x00, 0x00, 0x00, 0x00, 0x00,
0x00, 0x00, 0x00, 0x00, 0x00, 0x00, 0x00, 0x00, 0x00, 0x00, 0x00, 0x01, 0x00, 0x00, 0x00, 0x00,
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0x00, 0x00, 0x00, 0x00, 0x00, 0x00, 0x00, 0x00, 0x00, 0x00, 0x00, 0x00, 0x00, 0x00, 0x00, 0x00
};

PROGMEM const unsigned char partlycloudy [] = {
0x00, 0x00, 0x00, 0x00, 0x00, 0x00, 0x00, 0x00, 0x00, 0x00, 0x00, 0x00, 0x00, 0x00, 0x00, 0x00,
0x00, 0x00, 0x00, 0x00, 0x00, 0x00, 0x00, 0x00, 0x00, 0x00, 0x00, 0x00, 0x00, 0x00, 0x00, 0x00,
0x00, 0x00, 0x00, 0x00, 0x00, 0x00, 0x00, 0x00, 0x00, 0x00, 0x00, 0x00, 0x00, 0x00, 0x00, 0x00,
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0x00, 0x00, 0x00, 0x00, 0x00, 0x00, 0x00, 0x00, 0x00, 0x00, 0x00, 0x00, 0x00, 0x00, 0x00, 0x00
};

PROGMEM const unsigned char cloudy [] = {
0x00, 0x00, 0x00, 0x00, 0x00, 0x00, 0x00, 0x00, 0x00, 0x00, 0x00, 0x00, 0x00, 0x00, 0x00, 0x00,
0x00, 0x00, 0x00, 0x00, 0x00, 0x00, 0x00, 0x00, 0x00, 0x00, 0x00, 0x00, 0x00, 0x00, 0x00, 0x00,
0x00, 0x00, 0x00, 0x00, 0x00, 0x00, 0x00, 0x00, 0x00, 0x00, 0x00, 0x00, 0x00, 0x00, 0x00, 0x00,
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0x00, 0x00, 0x00, 0x00, 0x00, 0x00, 0x00, 0x00, 0x00, 0x00, 0x00, 0x00, 0x00, 0x00, 0x00, 0x00
};

PROGMEM const unsigned char chancetstorms [] = {
0x00, 0x00, 0x00, 0x00, 0x00, 0x00, 0x00, 0x00, 0x00, 0x00, 0x00, 0x00, 0x00, 0x00, 0x00, 0x00,
0x00, 0x00, 0x00, 0x00, 0x00, 0x20, 0x00, 0x00, 0x00, 0x00, 0x00, 0x00, 0x03, 0x33, 0x00, 0x00,
0x00, 0x00, 0x00, 0x00, 0x23, 0x77, 0x00, 0x00, 0x00, 0x00, 0x00, 0x00, 0x33, 0xFF, 0x60, 0x00,
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0x00, 0x00, 0x00, 0x00, 0x00, 0x00, 0x00, 0x00, 0x00, 0x00, 0x00, 0x00, 0x00, 0x00, 0x00, 0x00
};

double T,P,p0,p1;
int looper=0;
byte local_buff[129];

// ---------------------------------- peogram starts here ----------------------------------------------

void drawBitmap(int16_t x, int16_t y, const unsigned char *bitmap, int16_t w, int16_t h) 
{
  int16_t i, j, byteWidth = (w + 7) / 8;
  for(j=0; j<h; j++) {
    for(i=0; i<w; i++ ) {
      if(pgm_read_byte(bitmap + j * byteWidth + i / 8) & (128 >> (i & 7))) {
        oled.drawPixel(x+i, y+j, WHITE);
      }
    }
  } 
}

void ShowTemp(char x,char y) 
{
      oled.setCursor(x-36,y);
      oled.setTextSize(3);
      oled.print(round(T)); // don't print decimals
      oled.setCursor(x,y+1);
      oled.setTextSize(1);
      oled.println("C");
}

void setup()
{

  //power sensor via A2 (just above 3v is enough)
  pinMode(A2,OUTPUT);
  digitalWrite(A2,HIGH);

  oled.begin();
  oled.clear();
  oled.print(F("Init..."));
  // Initialize the sensor (it is important to get calibration values stored on the device).
  dht.begin();
  oled.update();
  delay(2000);
  oled.println(F("Ok!"));
  oled.update();
  Serial.begin(9600);
}
float h ;
float t;
float hic ;
void loop()
{
    Serial.print(F("LOOP\n"));
    oled.clear();
    // Wait for the measurement to complete:
    delay(1000);
  //  Serial.print(F("READING TEMP\n"));
    T = dht.readTemperature();
//    Serial.print(F("READ TEMP!\n"));
    ShowTemp(36,0);  
    delay(1000);
    h = dht.readHumidity();
    if (!isnan(h) && !isnan(T)) 
    {
      hic = dht.computeHeatIndex(T, h, false);// * 1.5;
      Serial.print(F("Humidity: "));
      Serial.print(h);
      Serial.print(F("\n"));
      Serial.print(F("Temperature: "));
      Serial.print(T);
      Serial.print(F(" *C \n"));
      // Print out the measurement:
      oled.setCursor(55,0);
      oled.setTextSize(2);
      oled.print(h);
      oled.setTextSize(1);
      oled.setCursor(114,8);
      oled.println(F("%"));

      oled.setCursor(60,19);
      oled.print(hic);
      oled.print(F(" heat"));
      oled.fillRect(0,48,h,5,WHITE); // draw bar
      oled.setCursor(h+2,45);
      oled.setTextSize(1);
      oled.print("Temp");
      
      oled.fillRect(0,54,T,5,WHITE); // draw bar
      oled.setCursor(T+2,53);
      oled.setTextSize(1);
      oled.print("Wilg");

      // separation line in the middle of the screen
      oled.drawLine(0,32,127,32,WHITE);
      oled.update();  
      delay(1000); //wait 1 sec
      looper++;
     
     if(!(looper%10)) 
     { // rotate screens every 10 seconds
         oled.clear();
//       if(p0<28.7)            drawBitmap(64,0,chancetstorms,64,64);   
//       if(p0>28.69&&p0<29.5)  drawBitmap(64,0,partlycloudy,64,64);
//       if(p0>29.49&&p0<30.5)  drawBitmap(64,0,cloudy,64,64);
       if(T>24.00)           drawBitmap(64,0,sunny,64,64);
       ShowTemp(50,20);  
       oled.update();
       delay(5000);
     }     
    }
}